## conf/distro/foss-base.conf
```bitbake
# Distribution specific configuration; software only configurations

require conf/distro/poky.conf
include conf/distro/foss-keys.inc

# Distro Naming
DISTRO_NAME = "FOSS Yocto Distribution"
#TRACK POKY DISTRO_VERSION
DISTRO_CODENAME = "foss"
SDK_VENDOR = "-foss"

# Clang Tool Chain
TOOLCHAIN ?= "clang"
#INHERIT_append = " scan-build"
#TOOLCHAIN_TARGET_TASK_append = " libc-staticdev"

# Init System
DISTRO_FEATURES_append = " systemd"
DISTRO_FEATURES_BACKFILL_CONSIDERED_append = " sysvinit"
VIRTUAL-RUNTIME_dev_manager = ""
VIRTUAL-RUNTIME_init_manager = "systemd"
VIRTUAL-RUNTIME_initscripts = "systemd-compat-units"
VIRTUAL-RUNTIME_login_manager = "shadow"

# Python
IMAGE_INSTALL_append = " python3"
IMAGE_INSTALL_append = " python3-systemd python3-pyserial python3-paho-mqtt"

# NTP
#IMAGE_INSTALL_remove = " ntp timesyncd"
#IMAGE_INSTALL_append = " chrony"

# Networking
PREFERRED_RPROVIDER_virtual/network-configuration = "networkd-dhcp-conf"
IMAGE_INSTALL_append = " iproute2 libmbim libqmi usb-modeswitch usb-modeswitch-data"
IMAGE_INSTALL_append = " iperf2 iperf3"
IMAGE_INSTALL_append = " jq mosquitto mosquitto-clients"

# Wifi
DISTRO_FEATURES_append = " wifi"
IMAGE_INSTALL_append = " hostapd"

# VPN
IMAGE_INSTALL_append = " wireguard-tools"

# Baseband, Connection Manager
DISTRO_FEATURES_append = " 3g"
#IMAGE_INSTALL_append = " ofono connman"
#IMAGE_INSTALL_remove = " modemmanager networkmanager"

# Baseband, Modem Manager
#DISTRO_FEATURES_remove = " 3g"
#IMAGE_INSTALL_remove = " ofono connman connman-gnome connman-client"
#IMAGE_INSTALL_append = " modemmanager networkmanager"

# GUI
DISTRO_FEATURES_append = " vulkan opengl"

# Virtualization
DISTRO_FEATURES_append = " virtualization"
IMAGE_INSTALL_append = " docker-ce"
VIRTUAL-RUNTIME_docker = "docker-ce"
#IMAGE_INSTALL_append = " podman"
#VIRTUAL-RUNTIME_docker = "podman"
VIRTUAL-RUNTIME_containerd = "containerd-opencontainers"
VIRTUAL-RUNTIME_runc = "runc-opencontainers"

# OTA Update
DISTRO_FEATURES_append = " usrmerge"
OSTREE_REPO = "${OSTREE_REPO_DIR}"
OSTREE_BRANCHNAME = "${MACHINE}"
OSTREE_OSNAME = "${DISTRO_CODENAME}"
#OSTREE_BOOTLOADER = "${PREFERRED_PROVIDER_virtual/bootloader}"
OSTREE_KERNEL_ARGS = " ramdisk_size=16384 rw rootfstype=ext4 rootwait rootdelay=2 ostree_root=LABEL=otaroot "

SOTA_CLIENT_remove = "aktualizr"
SOTA_CLIENT_PROV_remove = "aktualizr-auto-prov"
IMAGE_INSTALL_append_sota = " ostree os-release"
```

## conf/distro/foss-container.conf
```bitbake
# Distribution specific configuration; software only configurations

require conf/distro/poky.conf

# Distro Naming
DISTRO_NAME = "FOSS Yocto Container"
#TRACK POKY DISTRO_VERSION
DISTRO_CODENAME = "fosscontainer"
SDK_VENDOR = "-fosscontainer"

# Clang Tool Chain
TOOLCHAIN ?= "clang"
#INHERIT_append = " scan-build"
#TOOLCHAIN_TARGET_TASK_append = " libc-staticdev"

# Append poky based features
DISTRO_FEATURES_append = " virtualization"
DISTRO_FEATURES_append = " systemd"

# Add these binaries to the HOSTTOOLS_NONFATAL variable to allow them to
# be called from within the recipe build task. They are specified as
# NONFATAL as they are not installed at the same time on the build
# system.
HOSTTOOLS_NONFATAL_append = " sudo pidof dockerd podman newgidmap newuidmap"

# Use systemd as init manager
VIRTUAL-RUNTIME_init_manager = "systemd"
DISTRO_FEATURES_BACKFILL_CONSIDERED_append = " sysvinit"
VIRTUAL-RUNTIME_initscripts = ""
```

## conf/layer.conf
```bitbake
# distro-poky captures *only* open source configuration details

BBPATH .= ":${LAYERDIR}"

BBFILES += "${LAYERDIR}/recipes-*/*/*.bb \
            ${LAYERDIR}/recipes-*/*/*.bbappend"

BBFILE_COLLECTIONS += "distro-poky"
BBFILE_PATTERN_distro-poky := "^${LAYERDIR}/"
BBFILE_PRIORITY_distro-poky = "15"

LAYERSERIES_COMPAT_distro-poky = "gatesgarth dunfell zeus"

LAYERDEPENDS_distro-poky = "core yocto openembedded-layer clang-layer"

LAYERRECOMMENDS_distro-poky = "intel variscite-fslc"

# Dynamic Name Prefix is obtained from the conf/layer.conf associated to
# the specific layer as BBFILE_COLLECTIONS. Primarily dynamic-layers is
# for .bbappend files that perform overrides.

# nonclangable.conf packages are added to a dynamic layer that reflects the
# original layer of the package. The naming scheme follows as the original
# recipes-<recipe_collection>/<package>/<package>.bb; the .bbappend file is
# in the dynamic-layers with the same naming scheme including TOOLCHAIN="gcc"
# as the override. See the content of dynamic-layers, and duplicate the
# existing pattern.

# local-foss hook for branch specific foss layer, reference in conf/layer.conf
# local-closed hook for branch specific proprietary reference in conf/layer.conf

BBFILES_DYNAMIC += " \
    core:${LAYERDIR}/dynamic-layers/core/*/*/*.bb \
    core:${LAYERDIR}/dynamic-layers/core/*/*/*.bbappend \
    distro-poky:${LAYERDIR}/dynamic-layers/distro-poky/*/*/*.bb \
    distro-poky:${LAYERDIR}/dynamic-layers/distro-poky/*/*/*.bbappend \
    distro-ucos:${LAYERDIR}/dynamic-layers/distro-ucos/*/*/*.bb \
    distro-ucos:${LAYERDIR}/dynamic-layers/distro-ucos/*/*/*.bbappend \
    efi-secure-boot:${LAYERDIR}/dynamic-layers/efi-secure-boot/*/*/*.bb \
    efi-secure-boot:${LAYERDIR}/dynamic-layers/efi-secure-boot/*/*/*.bbappend \
    freescale-distro:${LAYERDIR}/dynamic-layers/freescale-distro/*/*/*.bb \
    freescale-distro:${LAYERDIR}/dynamic-layers/freescale-distro/*/*/*.bbappend \
    freescale-layer:${LAYERDIR}/dynamic-layers/freescale-layer/*/*/*.bb \
    freescale-layer:${LAYERDIR}/dynamic-layers/freescale-layer/*/*/*.bbappend \
    intel:${LAYERDIR}/dynamic-layers/intel/*/*/*.bb \
    intel:${LAYERDIR}/dynamic-layers/intel/*/*/*.bbappend \
    networking-layer:${LAYERDIR}/dynamic-layers/networking-layer/*/*/*.bb \
    networking-layer:${LAYERDIR}/dynamic-layers/networking-layer/*/*/*.bbappend \
    tpm:${LAYERDIR}/dynamic-layers/tpm/*/*/*.bb \
    tpm:${LAYERDIR}/dynamic-layers/tpm/*/*/*.bbappend \
    tpm2:${LAYERDIR}/dynamic-layers/tpm2/*/*/*.bb \
    tpm2:${LAYERDIR}/dynamic-layers/tpm2/*/*/*.bbappend \
    variscite-fslc:${LAYERDIR}/dynamic-layers/variscite-fslc/*/*/*.bb \
    variscite-fslc:${LAYERDIR}/dynamic-layers/variscite-fslc/*/*/*.bbappend \
    virtualization-layer:${LAYERDIR}/dynamic-layers/virtualization-layer/*/*/*.bb \
    virtualization-layer:${LAYERDIR}/dynamic-layers/virtualization-layer/*/*/*.bbappend \
"
```

## conf/machine/aaeon-bt06.conf
```bitbake
# Machine specific configuration; hardware only configurations

require conf/machine/intel-corei7-64.conf

# Bootloader
PREFERRED_PROVIDER_virtual/bootloader = "grub-efi"
EFI_PROVIDER = "grub-efi"
APPEND += "console=tty0"
GRUB_TIMEOUT = "3"
SERIAL_CONSOLES = "115200;ttyS1"
IMAGE_BOOT_FILES = "grubx64.efi"
GRUB_IMAGE = "grubx64.efi"

# Kernel
DISTRO_FEATURES_append = " luks security selinux polkit pam"
PREFERRED_VERSION_linux-yocto = "5.4%"
PREFERRED_PROVIDER_virtual/kernel = "linux-yocto"
KERNEL_FEATURES_append = ""

# Initramfs
INITRAMFS_IMAGE = "secure-core-image-initramfs"
DISTRO_FEATURES_NATIVE_append = " ima tpm tpm2 efi-secure-boot luks"
DISTRO_FEATURES_append = " ima tpm tpm2 efi-secure-boot luks modsign pam"
MACHINE_FEATURES_NATIVE_append = " efi"
MACHINE_FEATURES_append = " efi"

SECURE_CORE_IMAGE_EXTRA_INSTALL ?= "\
    packagegroup-efi-secure-boot \
    packagegroup-tpm \
    packagegroup-tpm2 \
    packagegroup-ima \
    packagegroup-luks \
"

WKS_FILE_sota = "otaefibootdisk.wks"
IMAGE_FSTYPES = " wic "
```

## conf/machine/adlink-cexpress-bl.conf
```bitbake
require conf/machine/intel-corei7-64.conf

# Bootloader
PREFERRED_PROVIDER_virtual/bootloader = "grub-efi"
EFI_PROVIDER = "grub-efi"
APPEND += "console=tty0"
GRUB_TIMEOUT = "3"
SERIAL_CONSOLES = "115200;ttyS1"
IMAGE_BOOT_FILES = "grubx64.efi"
GRUB_IMAGE = "grubx64.efi"

INITRAMFS_IMAGE = "secure-core-image-initramfs"
DISTRO_FEATURES_NATIVE_append = " ima tpm tpm2 efi-secure-boot luks"
DISTRO_FEATURES_append = " ima tpm tpm2 efi-secure-boot luks modsign pam"
MACHINE_FEATURES_NATIVE_append = " efi"
MACHINE_FEATURES_append = " efi"

SECURE_CORE_IMAGE_EXTRA_INSTALL ?= "\
    packagegroup-efi-secure-boot \
    packagegroup-tpm \
    packagegroup-tpm2 \
    packagegroup-ima \
    packagegroup-luks \
"

####################
# EOF
####################

# Inclusion for Machine Additions (Not Tracked)

# This file should be tracked by .gitignore; this
# allows a developer to incrementally test untracked
# changes.

include conf/machine/foss-additions.inc
```
